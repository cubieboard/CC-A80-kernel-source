## drivers/bus/Kconfig
```kconfig
#
# Bus Devices
#

menu "Bus devices"

config SUNXI_GTBUS
	bool "SUNXI GTBUS driver support"
	depends on ARM
	help
	  Driver supporting the gt bus for sun9i
	  platforms.

config SUNXI_MBUS
	bool "SUNXI MBUS driver support"
	depends on ARM
	help
	  Driver supporting the mbus for sun8i
	  platforms.
endmenu
```

## drivers/staging/iio/inv/Kconfig
```kconfig
#
# IIO IMU drivers configuration
#


source "drivers/staging/iio/inv/inv_sensors/Kconfig"
```

## drivers/video/sunxi/Kconfig
```kconfig
#
# Video configuration for sunxi platform
#

menu "Video support for sunxi"
	depends on FB

config FB_SUNXI
  tristate "DISP Driver Support(sunxi)"
  depends on (ARCH_SUN9IW1P1 || ARCH_SUN8IW5P1)
  default m
  ---help---

config FB_CONSOLE_SUNXI
  bool "Framebuffer Console Support(sunxi)"
  select FB_CFB_FILLRECT
  select FB_CFB_COPYAREA
  select FB_CFB_IMAGEBLIT
  default n
  ---help---

config LCD_SUNXI
  tristate "LCD Driver Support(sunxi)"
  depends on ((ARCH_SUN9IW1P1 || ARCH_SUN8IW5P1) && FB_SUNXI)
  default m
  ---help---

config HDMI_SUNXI
  tristate "HDMI Driver Support(sunxi)"
  depends on (ARCH_SUN9IW1P1 && FB_SUNXI)
  default m
  ---help---

config FB_SUNXI_LEGACY
  tristate "DISP Driver Support(sunxi-legacy)"
  depends on (ARCH_SUN8IW1P1 || ARCH_SUN8IW3P1)
  default m
  ---help---

config LCD_SUNXI_LEGACY
  tristate "LCD Driver Support(sunxi-legacy)"
  depends on ((ARCH_SUN8IW1P1 || ARCH_SUN8IW3P1) && FB_SUNXI_LEGACY)
  default m
  ---help---

config HDMI_SUNXI_LEGACY
  tristate "HDMI Driver Support(sunxi-legacy)"
  depends on ((ARCH_SUN8IW1P1 || ARCH_SUN8IW3P1) && FB_SUNXI_LEGACY)
  default m
  ---help---

config DISP2_SUNXI
  tristate "DISP Driver Support(sunxi-disp2)"
  depends on (ARCH_SUN8IW6)
  default n
  ---help---

config LCD_DISP2_SUNXI
  tristate "LCD Driver Support(sunxi-disp2)"
  depends on ((ARCH_SUN8IW6) && FB_SUNXI)
  default n
  ---help---

endmenu
```

## modules/mali/Kconfig
```kconfig
menu "Mali"

config MALI_LINUX_ENV
	bool "Mali in Linux enviorment"
	depends on ARCH_SUNXI
	default n
	help
	  Say 'y' if mali will run in Linux enviorment.
	  Say 'n' if run in Android enviorment.
endmenu
```

## sound/soc/sunxi/audiocodec/Kconfig
```kconfig
config SND_SUNXI_SOC_AUDIOCODEC
	tristate "Audiocodec for the SUNXI chips"
	depends on ARCH_SUN8IW3 || ARCH_SUN8IW5 || ARCH_SUN8IW1
	select SND_SOC_DMAENGINE_PCM
	default n
	help
	  Say Y or M if you want to add support for audiocodec
config SND_SUN8IW1_SNDCODEC
	tristate "Audiocodec for the SUN8IW1 chips"
	depends on ARCH_SUN8IW1
	default n
	help
	  Say Y or M if you want to add sun8iw1 audiocodec support
config SND_SUN8IW3_SNDCODEC
	tristate "Audiocodec for the SUN8IW3 chips"
	depends on ARCH_SUN8IW3
	default n
config SND_SUN8IW5_SNDCODEC
       tristate "Audiocodec for the SUN8IW5 chips"
       depends on ARCH_SUN8IW5
       default n
       help
         Say Y or M if you want to add sun8iwX audiocodec support

config SND_SUNXI_SWITCH
       tristate "headset for the SUN8IW5 chips"
       depends on ARCH_SUN8IW5
       default n
	help
         Say Y or M if you want to add sun8iwX headset support
```

## sound/soc/sunxi/daudio0/Kconfig
```kconfig
config SND_SUNXI_SOC_DAUDIO_INTERFACE
	tristate "SoC daudio tdm interface for SUNXI chips"
	depends on ARCH_SUN9IW1 || ARCH_SUN8IW6
	select SND_SOC_DMAENGINE_PCM
	default n
	help
	  Say Y or M if you want to add support for codecs attached to
	  the SUNXI DAUDIO TDM interface. You will also need
	  to select the audio interfaces to support below.
```

## sound/soc/sunxi/hdmiaudio/Kconfig
```kconfig
config SND_SUNXI_SOC_HDMIAUDIO
	tristate "HDMI Audio for SUNXI chips"
	depends on ARCH_SUN9IW1 || ARCH_SUN8IW6 || ARCH_SUN8IW1
	select SND_SOC_DMAENGINE_PCM
	default n
	help
	  Say Y or M if you want to add support for hdmi audio
```
